area.reset
;area.view
SYStem.RESet
;SYStem.JtagClock 5mhz
;sys.detect DAISYCHAIN
SYStem.CPU CORTEXA55
SYStem.CONFIG CORENUMBER  8
SYStem.CONFIG.CORE 1. 1.

CORE.NUMBer 8
;CORE.ASSIGN 5. ;assign the physical cores 1, 2, 3, and 4

SYStem.CONFIG COREBASE       DAP:0x80404000 DAP:0x80405000 DAP:0x80406000 DAP:0x80407000     DAP:0x80424000 DAP:0x80425000 DAP:0x80426000 DAP:0x80427000
SYStem.CONFIG CTIBASE        DAP:0x80414000 DAP:0x80415000 DAP:0x80416000 DAP:0x80417000     DAP:0x80434000 DAP:0x80435000 DAP:0x80436000 DAP:0x80437000

SYStem.CONFIG.ETM BASE       APB:0x3141c000 APB:0x3141d000 APB:0x3141e000 APB:0x3141f000 APB:0X3143C000 APB:0X3143D000 APB:0X3143E000 APB:0X3143F000
SYSTEM.CONFIG.FUNNEL1.BASE  APB:0x31010000
SYSTEM.CONFIG.FUNNEL2.BASE  APB:0x31011000
;SYSTEM.CONFIG.TPIU.BASE APB:0x31015000

SYStem.CONFIG.FUNNEL1.ATBSource ETM.0 0 ETM.1 1 ETM.2 2 ETM.3 3
SYStem.CONFIG.FUNNEL2.ATBSource FUNNEL1 4 ETM.4 0 ETM.5 1 ETM.6 2  ETM.7 3
SYSTEM.CONFIG.ETF.BASE  APB:0x31012000
SYSTEM.CONFIG.ETF.atbsource    FUNNEL2 

SYSTEM.CONFIG.REPlicator1.Base APB:0x31014000
SYSTEM.CONFIG.REPlicator1.ATBSource ETF

SYSTEM.CONFIG.ETB.Base APB:0x31013000
SYSTEM.CONFIG.ETB.ATBSource REPlicatorA1 

;SYStem.CONFIG.TPIU.ATBSource FUNNEL2

;;SYSTEM.CONFIG.FUNNEL1.Atbsource  ETM 0 //
;SYSTEM.CONFIG.FUNNEL1.Atbsource  ETM 1 //
;SYSTEM.CONFIG.FUNNEL1.Atbsource  ETM 2 //
;SYSTEM.CONFIG.FUNNEL1.Atbsource  ETM 3 //

;SYSTEM.CONFIG.FUNNEL2.Atbsource  ETM 0 //
;SYSTEM.CONFIG.FUNNEL2.Atbsource  ETM 1 //
;SYSTEM.CONFIG.FUNNEL2.Atbsource  ETM 2 //
;SYSTEM.CONFIG.FUNNEL2.Atbsource  ETM 3 //
;SYSTEM.CONFIG.FUNNEL2.Atbsource  FUNNEL1 //

;SYSTEM.CONFIG.ETF.BASE  DAP:0x31012000
;SYSTEM.CONFIG.ETF.atbsource    FUNNEL2  //


 
SyStem.Option IMASKASM ON
SyStem.Option IMASKHLL ON
SyStem.Option ENRESET  OFF
SyStem.Option resbreak OFF
trace.autoarm off
SYStem.CONFIG MEMORYACCESSPORT 1
SYStem.CONFIG DEBUGACCESSPORT  0
SYStem.CONFIG APBACCESSPORT    0
SYStem.CONFIG AHBACCESSPORT    0
SYStem.CONFIG AXIACCESSPORT    2
system.config corejtagport     0
system.config jtagaccessport   0

SYStem.JtagClock 10mhz

SYStem.MemAccess DAP 

sYmbol.SourcePATH.List
sYmbol.SourcePATH.Translate  "/home/tomhou/data/rtos/"  "Z:\data\rtos\"
sYmbol.SourcePATH.Translate  "/home/tomhou/data/test"  "Z:\data\test\"
data.load.elf  "Z:\data\test\bin\case.elf"   /nocode

system.mode attach  ;会将core 强制改为core0

list
